## package/grafana/Config.in
```kconfig
config BR2_PACKAGE_GRAFANA
	bool "grafana"
	help
      Grafana time-series visualization.
```

## package/influxdb/Config.in
```kconfig
config BR2_PACKAGE_INFLUXDB
	bool "influxdb"
	help
      InfluxDB time-series database.
```
